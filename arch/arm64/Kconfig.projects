## arch/arm64/Kconfig.projects
```kconfig
config SEC_O1Q_PROJECT
	default n
	bool "Samsung O1Q Project"
	help
	  Support for Samsung O1Q Project

config MACH_O1Q_CHN_OPENX
        default n
        bool "Samsung O1Q CHN OPENX"
        help
          Support for Samsung O1Q CHN OPENX device.

config MACH_O1Q_CHN_HKX
        default n
        bool "Samsung O1Q CHN HKX"
        help
          Support for Samsung O1Q CHN HKX device.

config SEC_T2Q_PROJECT
	default n
	bool "Samsung T2Q Project"
	help
	  Support for Samsung T2Q Project

config MACH_T2Q_CHN_OPENX
        default n
        bool "Samsung T2Q CHN OPENX"
        help
          Support for Samsung T2Q CHN OPENX device.

config MACH_T2Q_CHN_HKX
        default n
        bool "Samsung T2Q CHN HKX"
        help
          Support for Samsung T2Q CHN HKX device.
```

## techpack/dataipa/drivers/platform/msm/gsi/Kconfig
```kconfig
menuconfig GSI
    tristate "GSI"
    default y
    ---help---
        GSI support
```

## techpack/dataipa/drivers/platform/msm/ipa/Kconfig
```kconfig
menuconfig IPA3
    tristate "IPA"
    default y
    ---help---
        IPA3 support

menuconfig IPA_EMULATION
    tristate "IPA Emulation"
    default n
    ---help---
        IPA3 emulation support

menuconfig IPA3_REGDUMP
    tristate "IPA Regdump"
    default n
    ---help---
        IPA3 regdump support

menuconfig RNDIS_IPA
    tristate "IPA RNDIS"
    default y
    depends on IPA3
    ---help---
        IPA RNDIS

menuconfig IPA3_MHI_PROXY
    tristate "IPA3 MHI Proxy"
    default y
    depends on IPA3
    ---help---
        IPA MHI proxy support

menuconfig IPA3_MHI_PRIME_MANAGER
    tristate "IPA3 MHI prime manager"
    default y
    depends on IPA3_MHI_PROXY
    ---help---
        IPA MHI prine manager

menuconfig RMNET_IPA3
    tristate "RMNET IPA"
    default y
    depends on IPA3
    ---help---
        IPA RMNET support

menuconfig IPA_UT
    tristate "IPA UT"
    default y
    depends on IPA3
    ---help---
        IPA UT support
```
